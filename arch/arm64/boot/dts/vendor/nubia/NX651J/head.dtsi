/*
 * nubia overwrite dts
 */

#include "audio.dtsi"
#include "tp.dtsi"
#include "others.dtsi"
#include "display.dtsi"
#include "leds.dtsi"
#include "haptics.dtsi"
#include "touchkey.dtsi"
#include "aw22xxx.dtsi"
#include "finger.dtsi"
#include "nfc.dtsi"
#include "neo-power.dtsi"
#include "sensors.dtsi"
